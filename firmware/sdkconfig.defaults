## firmware/sdkconfig.defaults
```kconfig
# ESP32-S3FN8 (8 MB quad flash), wired Ethernet only, USB Serial/JTAG console.
CONFIG_IDF_TARGET="esp32s3"
CONFIG_ESPTOOLPY_FLASHSIZE_8MB=y
CONFIG_ESPTOOLPY_FLASHMODE_QIO=y
CONFIG_PARTITION_TABLE_CUSTOM=y
CONFIG_PARTITION_TABLE_CUSTOM_FILENAME="partitions.csv"

# W5500 over SPI
CONFIG_ETH_USE_SPI_ETHERNET=y
CONFIG_ETH_SPI_ETHERNET_W5500=y
CONFIG_ETH_USE_ESP32_EMAC=n

# No radio
CONFIG_ESP_WIFI_ENABLED=n
CONFIG_BT_ENABLED=n

# Console on USB Serial/JTAG
CONFIG_ESP_CONSOLE_USB_SERIAL_JTAG=y
CONFIG_ESP_CONSOLE_SECONDARY_NONE=y

# Watchdog
CONFIG_ESP_TASK_WDT_EN=y
CONFIG_ESP_TASK_WDT_INIT=y
CONFIG_ESP_TASK_WDT_TIMEOUT_S=15
CONFIG_ESP_TASK_WDT_PANIC=y

# Brownout + logging
CONFIG_ESP_BROWNOUT_DET=y
CONFIG_LOG_DEFAULT_LEVEL_INFO=y
CONFIG_HTTPD_MAX_REQ_HDR_LEN=1024
```
